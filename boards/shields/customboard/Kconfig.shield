## boards/shields/customboard/dts/bindings/gpio/pca9555.yml
```yaml
# SPDX-License-Identifier: Apache-2.0

# description: TCA9555 GPIO Expander

# compatible: "ti,tca9555"

# include: [i2c-device.yaml, gpio-controller.yaml]

# properties:

#   ngpios:
#     type: int
#     required: true
#     description: Number of GPIOs (typically 16 for TCA9555)

#   int-gpios:
#     type: phandle-array
#     required: false
#     description: Optional interrupt pin from the expander



# description: TCA9555 GPIO Expander

# compatible: "ti,tca9555"

# include: base.yaml

# properties:
#   "#gpio-cells":
#     type: int
#     const: 2
#     required: true

#   gpio-controller:
#     type: boolean

#   int-gpios:
#     type: phandle-array
#     required: false
  
#   ngpios:
#     type: int
#     required: true
#     description: no.of gpios




# gpio-cells:
#   - pin
#   - flags



# Copyright 2024 NXP
# SPDX-License-Identifier: Apache-2.0
description: NXP PCA9555 I2C GPIO expander

compatible: "nxp,pca95xx"

include: nxp,pca_series.yaml

properties:
  ngpios:
    required: true
    const: 16
```

## boards/shields/customboard/dts/bindings/gpio/tca9555.yml
```yaml
# SPDX-License-Identifier: Apache-2.0

# description: TCA9555 GPIO Expander

# compatible: "ti,tca9555"

# include: [i2c-device.yaml, gpio-controller.yaml]

# properties:

#   ngpios:
#     type: int
#     required: true
#     description: Number of GPIOs (typically 16 for TCA9555)

#   int-gpios:
#     type: phandle-array
#     required: false
#     description: Optional interrupt pin from the expander



description: TCA9555 GPIO Expander

compatible: "ti,tca9555"

include: base.yaml

properties:
  "#gpio-cells":
    type: int
    const: 2
    required: true

  gpio-controller:
    type: boolean

  int-gpios:
    type: phandle-array
    required: false
  
  ngpios:
    type: int
    required: true
    description: no.of gpios




gpio-cells:
  - pin
  - flags
```

## config/west.yml
```yaml
manifest:
  remotes:
    - name: customboard
      url-base: https://github.com/hjw1112/customboard-zmk-config
    - name: zmk
      remote: zmkfirmware
      revision: main
      import: app/west.yml
    - name: customboard-zmk-config
      remote: custom
      revision: main
  self:
    path: config
```
